MEMORY
{
  FLASH   (rx)  : ORIGIN = 0xc0de0000, LENGTH = 400K
  DATA    (r)   : ORIGIN = 0xc0de0000, LENGTH = 400K
  SRAM    (rwx) : ORIGIN = 0xda7a0000, LENGTH = 30K
}

PAGE_SIZE  = 512;
STACK_SIZE = 1500;
END_STACK  = ORIGIN(SRAM) + LENGTH(SRAM);